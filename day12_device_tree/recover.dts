/dts-v1/;

/ {
	model = "YL virtual board";
	compatible = "yl,virtual-board";
	#address-cells = <0x02>;
	#size-cells = <0x02>;

	i2c@1000 {
		compatible = "demo,i2c-controller";
		reg = <0x00 0x1000 0x00 0x100>;
		#address-cells = <0x01>;
		#size-cells = <0x00>;

		temperature@48 {
			compatible = "demo,temp-sensor";
			reg = <0x48>;
			status = "okay";
		};
	};
};
