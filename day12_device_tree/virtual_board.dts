/dts-v1/;

/ {
    model = "YL virtual board";
    compatible = "yl,virtual-board";

    #address-cells = <2>;
    #size-cells = <2>;

    i2c@1000 {
        compatible = "demo,i2c-controller";
        reg = <0x0 0x1000 0x0 0x100>;

        #address-cells = <1>;
        #size-cells = <0>;

        temperature@48 {
            compatible = "demo,temp-sensor";
            reg = <0x48>;
            status = "okay";
        };
    };
};